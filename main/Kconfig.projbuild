## main/Kconfig.projbuild
```kconfig
menu "Ejemplo de configuracion"

config WIFI_SSID
    string "Wi-Fi ssid"
    default "myssid"

config WIFI_PSWD
    string "Wi-Fi password"
    default "mypassword"

config DEVICE_VERSION
    string "Device version"
    default "1.0.0"

menu "aliyun config"
    config ALIYUN_META_PRODUCT_KEY
        string "Aliyun product key"
        default "xxxx"
        help 
            Aliyun product key.

    config ALIYUN_META_PRODUCT_SECRET
        string "Aliyun product secret"
        default "xxxx"
        help
            Aliyun product secret.

    config ALIYUN_META_DEVICE_NAME
        string "Aliyun device name"
        default "xxxx"
        help 
            Aliyun device name

    config ALIYUN_META_DEVICE_SECRET
        string "Aliyun device secret"
        default "xxxx"
        help
            Aliyun device secret
endmenu

endmenu


menu "conf of meshwifi"

    choice DEVICE_TYPE
        bool "configure device type"
        default DEVICE_TYPE_NODE
        help
            configura como root o nodo
    
    config DEVICE_TYPE_ROOT
        bool "root device"
    
    config DEVICE_TYPE_NODE
        bool "non-root-device"

    endchoice
        
    config DEVICE_TYPE
        int 
        default 1 if DEVICE_TYPE_ROOT
        default 2 if DEVICE_TYPE_NODE
    
    config MESH_ID
        string "MESH ID"
            default "123456"
            help 
                
                crea el mesh id
    
    config MESH_CHANNEL
        int "mesh channel net"
        range 1 14 
        default 13
        help    
            mesh net channel select 

endmenu
```
